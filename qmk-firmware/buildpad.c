#include QMK_KEYBOARD_H

/* =========================================================
                     BONGO CONFIG
   ========================================================= */

#define ANIM_FRAME_DURATION 75
#define ANIM_SIZE 636
#define IDLE_FRAMES 5
#define IDLE_TIMEOUT 750
#define TAP_FRAMES 2

enum anim_states {
    Idle,
    Prep,
    Tap
};

/* =========================================================
                        GLOBALS
   ========================================================= */

static bool last_button_state = true;
static uint32_t boot_timer = 0;
static uint32_t layer_popup_timer = 0;
static bool show_layer_popup = false;
static uint32_t anim_timer = 0;
static uint32_t idle_timer = 0;
static uint8_t current_idle_frame = 0;
static uint8_t current_tap_frame = 0;
static uint8_t anim_state = Idle;

/* =========================================================
                      BONGO ARRAYS
   ========================================================= */


static const char PROGMEM idle[IDLE_FRAMES][ANIM_SIZE] =
{
    {
        0x00, 0x00, 0x00, 0x00, 0x00, 0x00, 0x00, 0x00, 0x00, 0x00, 0x00, 0x00,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 0x00,
        0x00, 0x00, 0x00, 0x00, 0x00, 0x00, 0x00, 0x00, 0x00, 0x00, 0x00, 0x00,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 0x01,
        0x00, 0x00, 0x00, 0x00, 0x00, 0x00, 0x00, 0x00, 0x00, 0x00, 0x00, 0x00,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 0x00,
        0x00, 0x00, 0x00, 0x00, 0x00, 0x00, 0x00, 0x00, 0x00, 0x00, 0x00, 0x00,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 0x00
    },
    {
        0x00, 0x00, 0x00, 0x00, 0x00, 0x00, 0x00, 0x00, 0x00, 0x00, 0x00, 0x00,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 0x00,
        0x00, 0x00, 0x00, 0x00, 0x00, 0x00, 0x00, 0x00, 0x00, 0x00, 0x00, 0x00,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 0x01,
        0x00, 0x00, 0x00, 0x00, 0x00, 0x00, 0x00, 0x00, 0x00, 0x00, 0x00, 0x00,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 0x00,
        0x00, 0x00, 0x00, 0x00, 0x00, 0x00, 0x00, 0x00, 0x00, 0x00, 0x00, 0x00,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 0x00
    },
    {
        0x00, 0x00, 0x00, 0x00, 0x00, 0x00, 0x00, 0x00, 0x00, 0x00, 0x00, 0x00,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 0x00,
        0x00, 0x00, 0x00, 0x00, 0x00, 0x00, 0x00, 0x00, 0x00, 0x00, 0x00, 0x00,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 0x01,
        0x00, 0x00, 0x00, 0x00, 0x00, 0x00, 0x00, 0x00, 0x00, 0x00, 0x00, 0x00,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 0x00,
        0x00, 0x00, 0x00, 0x00, 0x00, 0x00, 0x00, 0x00, 0x00, 0x00, 0x00, 0x00,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 0x00
    },
    {
        0x00, 0x00, 0x00, 0x00, 0x00, 0x00, 0x00, 0x00, 0x00, 0x00, 0x00, 0x00,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 0x00,
        0x00, 0x00, 0x00, 0x00, 0x00, 0x00, 0x00, 0x00, 0x00, 0x00, 0x00, 0x00,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 0x01,
        0x00, 0x00, 0x00, 0x00, 0x00, 0x00, 0x00, 0x00, 0x00, 0x00, 0x00, 0x00,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 0x00,
        0x00, 0x00, 0x00, 0x00, 0x00, 0x00, 0x00, 0x00, 0x00, 0x00, 0x00, 0x00,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 0x00
    },
    {
        0x00, 0x00, 0x00, 0x00, 0x00, 0x00, 0x00, 0x00, 0x00, 0x00, 0x00, 0x00,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 0x00,
        0x00, 0x00, 0x00, 0x00, 0x00, 0x00, 0x00, 0x00, 0x00, 0x00, 0x00, 0x00,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 0x01,
        0x00, 0x00, 0x00, 0x00, 0x00, 0x00, 0x00, 0x00, 0x00, 0x00, 0x00, 0x00,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 0x00,
        0x00, 0x00, 0x00, 0x00, 0x00, 0x00, 0x00, 0x00, 0x00, 0x00, 0x00, 0x00,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 0x00
    }
};


static const char PROGMEM prep[][ANIM_SIZE] =
{
    {
        0x00, 0x00, 0x00, 0x00, 0x00, 0x00, 0x00, 0x00, 0x00, 0x00, 0x00, 0x00,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 0x00,
        0x00, 0x00, 0x00, 0x00, 0x00, 0x00, 0x00, 0x00, 0x00, 0x00, 0x00, 0x00,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 0x01,
        0x00, 0x00, 0x00, 0x00, 0x00, 0x00, 0x00, 0x00, 0x00, 0x00, 0x00, 0x00,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 0x00,
        0x00, 0x00, 0x00, 0x00, 0x00, 0x00, 0x00, 0x00, 0x00, 0x00, 0x00, 0x00,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 0x00
    }
};

static const char PROGMEM tap[TAP_FRAMES][ANIM_SIZE] =
{
    {
        0x00, 0x00, 0x00, 0x00, 0x00, 0x00, 0x00, 0x00, 0x00, 0x00, 0x00, 0x00,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 0x00,
        0x00, 0x00, 0x00, 0x00, 0x00, 0x00, 0x00, 0x00, 0x00, 0x00, 0x00, 0x00,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 0x01,
        0x00, 0x00, 0x00, 0x00, 0x00, 0x00, 0x00, 0x00, 0x00, 0x00, 0x00, 0x00,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 0x00,
        0x00, 0x00, 0x00, 0x00, 0x00, 0x00, 0x00, 0x00, 0x00, 0x00, 0x00, 0x00,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 0x00
    },
    {
        0x00, 0x00, 0x00, 0x00, 0x00, 0x00, 0x00, 0x00, 0x00, 0x00, 0x00, 0x00,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 0x00,
        0x00, 0x00, 0x00, 0x00, 0x00, 0x00, 0x00, 0x00, 0x00, 0x00, 0x00, 0x00,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 0x01,
        0x00, 0x00, 0x00, 0x00, 0x00, 0x00, 0x00, 0x00, 0x00, 0x00, 0x00, 0x00,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 0x00,
        0x00, 0x00, 0x00, 0x00, 0x00, 0x00, 0x00, 0x00, 0x00, 0x00, 0x00, 0x00,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 0x00
    }
};


/* =========================================================
                        BOOT
   ========================================================= */

void keyboard_post_init_kb(void) {

    gpio_set_pin_input_high(GP7);

    boot_timer = timer_read32();

    keyboard_post_init_user();
}

/* =========================================================
                    ENCODER PUSH
   ========================================================= */

void housekeeping_task_kb(void) {

    bool current_state = gpio_read_pin(GP7);

    if (last_button_state && !current_state) {

        if (get_highest_layer(layer_state) == 0) {
            layer_move(1);
        } else {
            layer_move(0);
        }

        show_layer_popup = true;
        layer_popup_timer = timer_read32();

        anim_state = Tap;
        anim_timer = timer_read32();
    }

    last_button_state = current_state;

    housekeeping_task_user();
}

/* =========================================================
                    KEY PRESS DETECTION
   ========================================================= */

bool process_record_kb(uint16_t keycode, keyrecord_t *record) {

    if (record->event.pressed) {

        anim_state = Tap;
        anim_timer = timer_read32();
        idle_timer = timer_read32();
    }

    return process_record_user(keycode, record);
}

/* =========================================================
                        BONGO
   ========================================================= */

#ifdef OLED_ENABLE

static void draw_bongo(void) {

    switch (anim_state) {

        case Idle:

            current_idle_frame =
                (timer_read32() / ANIM_FRAME_DURATION)
                % IDLE_FRAMES;

            oled_write_raw_P(
                idle[current_idle_frame],
                ANIM_SIZE
            );

            break;

        case Prep:

            oled_write_raw_P(
                prep[0],
                ANIM_SIZE
            );

            break;

        case Tap:

            current_tap_frame =
                (timer_elapsed32(anim_timer)
                 / ANIM_FRAME_DURATION)
                % TAP_FRAMES;

            oled_write_raw_P(
                tap[current_tap_frame],
                ANIM_SIZE
            );

            break;
    }
}

static void update_bongo_state(void) {

    uint16_t elapsed = timer_elapsed32(anim_timer);

    switch (anim_state) {

        case Idle:
            break;

        case Prep:

            if (elapsed > ANIM_FRAME_DURATION) {

                anim_state = Tap;
                anim_timer = timer_read32();
            }

            break;

        case Tap:

            if (elapsed >
                (ANIM_FRAME_DURATION * TAP_FRAMES)) {
                anim_state = Idle;
            }

            break;
    }

    if (timer_elapsed32(idle_timer) > IDLE_TIMEOUT) {
        anim_state = Idle;
    }
}

/* =========================================================
                  OLED
   ========================================================= */

bool oled_task_kb(void) {

    oled_clear();

    /* ==========================
             BUILDPAD BOOT PPPUP
       ========================== */

    if (timer_elapsed32(boot_timer) < 2000) {

        oled_set_cursor(3, 1);
        oled_write_ln("BuildPad", false);

        oled_set_cursor(2, 3);
        oled_write_ln("by Pranay", false);

        return false;
    }

    /* ==========================
             LAYER POPUP
       ========================== */

    if (show_layer_popup) {

        if (timer_elapsed32(layer_popup_timer)
            < 1000) {

            oled_set_cursor(4, 1);

            if (get_highest_layer(layer_state) == 0) {
                oled_write_ln("MEDIA", false);

            } 
            else {
                oled_write_ln("TOOLS", false);
            }

            return false;

        } 
        else {
            show_layer_popup = false;
        }
    }

    /* ==========================
                BONGO
       ========================== */

    update_bongo_state();

    draw_bongo();

    return false;
}

#endif
